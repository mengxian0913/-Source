#include <stdio.h>
#include "NUC100Series.h"
#include "MCU_init.h"
#include "SYS_init.h"
#include "LCD.h"
#include "Scankey.h"


int flag = 2;


void GPAB_IRQHandler(void)
{
    if (PA->ISRC & BIT0 && flag == 2) {        // check if PB12 interrupt occurred
        PA->ISRC |= BIT0;         // clear PB12 interrupt status
			  flag = 3;               // set a flag for PB12(KEY1)
    } else if (PA->ISRC & BIT1) { // check if Pb13 interrupt occurred
        PA->ISRC |= BIT1;         // clear PB13 interrupt status  
        flag = 2;	              // set a flag for PB13(KEY2)
    } else if (PA->ISRC & BIT2 && flag == 2) { // check if PB14 interrupt occurred
        PA->ISRC |= BIT2;         // clear PB14 interrupt status  
        flag = 1;	              // set a flag for PB14(KEY3)			
    } else {                      // else it is unexpected interrupts
        PA->ISRC = PA->ISRC;	      // clear all GPB pins
				PA0 = PA1 = PA2 = 1;
		}
}

void Init_KEY(void)
{
    GPIO_SetMode(PA, (BIT3 | BIT4 | BIT5), GPIO_MODE_OUTPUT);
		GPIO_SetMode(PA, (BIT0 | BIT1 | BIT2), GPIO_MODE_QUASI);
    GPIO_EnableInt(PA, 0, GPIO_INT_FALLING);
    GPIO_EnableInt(PA, 1, GPIO_INT_FALLING);
    GPIO_EnableInt(PA, 2, GPIO_INT_FALLING);		
    NVIC_EnableIRQ(GPAB_IRQn);   
    GPIO_SET_DEBOUNCE_TIME(GPIO_DBCLKSRC_LIRC, GPIO_DBCLKSEL_64);
    GPIO_ENABLE_DEBOUNCE(PA, (BIT0 | BIT1 | BIT2));
	  PA3 = PA4 = PA5 = 0;
}


unsigned char map[128*8] = { // Nuvoton Logo 
	0x00,0x00,0x00,0x00,0x00,0x00,0x00,0x00,0x00,0x00,0x00,0x00,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0x00,
	0x00,0x00,0x00,0x00,0x00,0x00,0x80,0xC0,0xE0,0xE0,0xE0,0x60,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0x00,
	0x00,0x00,0x00,0x00,0x00,0x00,0x7F,0x7F,0x7F,0x7F,0x00,0x00,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0x00,
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	0x00,0x00,0x00,0x00,0x00,0x00,0x00,0x00,0x00,0x00,0x00,0x00,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0x00
};

void scrollRight() {
	unsigned char tmp[10];
	int i = 0, j = 0;
	for(i = 0, j = 127; i < 8; i++) {
		tmp[i] = map[j];
		j += 128;
	}
	
	for(i = 127; i >= 1; i--) {
		for(j = 0; j < 8; j++) {
			map[128 * j + i] = map[128 * j + i - 1];
		}
	}
	
	for(i = 0; i < 8; i++) {
		map[128 * i] = tmp[i];
	}

	return;
}

void scrollLeft() {
	
	unsigned char tmp[10];
	int i = 0, j = 0;
	for(i = 0; i < 8; i++) {
		tmp[i] = map[128 * i];
	}
	
	for(i = 0; i < 128 - 1; i++) {
		for(j = 0; j < 8; j++) {
			map[128 * j + i] = map[128 * j + i + 1];
		}
	}
	
	for(i = 0; i < 8; i++) {
		map[128 * i + 127] = tmp[i];
	}

	return;
}



int main(void)
{
	int i = 5, keyPressed = 0;
	int currentStatus = 0;
	SYS_Init();
	Init_KEY();
	OpenKeyPad();
	init_LCD();
	clear_LCD();
  
	
	while(1) {
		draw_LCD(map);
		
		if ( flag == 1 ) {
			scrollLeft();
		} else if ( flag == 3 ) {
			scrollRight();
		}
	}
	
}
